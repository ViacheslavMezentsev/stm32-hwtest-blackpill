# STM32F401_F411_TEST_SUBSET register map
File version: 1.0
Authored project test subset; RM0368, RM0383 and PM0214. Not a complete vendor SVD.
Registers are 32-bit, read-write, no defined reset value unless marked. A register's access mark holds for its fields unless they carry their own. Offsets are from the block's base; lines under a group give offsets from that group; [hi:lo] are bit positions; {n}, {i} and the like mark numbered series; 'fields as' and 'values as' point back to an identical list; <NAME> marks a mode.

## Memory map
0x1FFF7A22 FACTORY
0x40000000 TIM2
0x40002800 RTC
0x40012000 ADC1
0x40012300 ADC
0x40020800 GPIOC
0x40023800 RCC
0x40026400 DMA2
0x40026410 DMA2_Stream0
0xE000E010 SysTick
0xE000E100 NVIC
0xE000ED00 SCB
0xE0042000 DBGMCU

## RCC
Base 0x40023800
0x00 CR
0x08 CFGR
0x30 AHB1ENR

## GPIOC
Base 0x40020800
0x00 MODER
0x04 OTYPER
0x08 OSPEEDR
0x0C PUPDR
0x14 ODR

## ADC1
Base 0x40012000
0x04 CR1
0x08 CR2
0x2C SQR1
0x34 SQR3
0x4C DR ro read-clears

## ADC
Base 0x40012300
0x04 CCR

## DMA2
Base 0x40026400
0x00 LISR ro
0x08 LIFCR wo write-1-clears

## DMA2_Stream0
Base 0x40026410
0x00 CR
0x04 NDTR
0x08 PAR
0x0C M0AR

## TIM2
Base 0x40000000
0x00 CR1
0x0C DIER
0x10 SR write-0-clears
0x28 PSC
0x2C ARR

## RTC
Base 0x40002800
0x10 PRER
0x1C ALRMAR

## SCB
Base 0xE000ED00
0x04 ICSR
0x10 SCR

## SysTick
Base 0xE000E010
0x00 CTRL read-clears
0x04 LOAD

## NVIC
Base 0xE000E100
0x00 ISER0 write-1-sets
0x04 ISER1 write-1-sets
0x80 ICER0 wo write-1-clears
0x84 ICER1 wo write-1-clears

## DBGMCU
Base 0xE0042000
0x00 IDCODE ro

## FACTORY
Base 0x1FFF7A22
0x00 FLASH_SIZE 16-bit ro
0x08 VREFINT_CAL 16-bit ro
0x0A TS_CAL1 16-bit ro
0x0C TS_CAL2 16-bit ro
